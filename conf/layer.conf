## conf/layer.conf
```bitbake
# We have a conf and classes directory, add to BBPATH
BBPATH ?= ""
BBPATH .= ":${LAYERDIR}"

# We have a packages directory, add to BBFILES
BBFILES += "${LAYERDIR}/recipes-*/*/*.bb \
            ${LAYERDIR}/recipes-*/*/*.bbappend"

# Let us add layer-specific bbappends which are only applied when that
# layer is included in our configuration
BBFILES += "${@' '.join('${LAYERDIR}/%s/recipes*/*/*.bbappend' % layer \
               for layer in BBFILE_COLLECTIONS.split())}"

BBFILE_COLLECTIONS += "sourcery-analyzer-layer"
BBFILE_PATTERN_sourcery-analyzer-layer = "^${LAYERDIR}/"
BBFILE_PRIORITY_sourcery-analyzer-layer = "6"

#BB_DANGLINGAPPENDS_WARNONLY = "1"
```
